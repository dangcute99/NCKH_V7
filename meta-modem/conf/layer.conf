## meta-modem/conf/layer.conf
```bitbake
BBPATH .= ":${LAYERDIR}"
BBFILES += "${LAYERDIR}/recipes-*/*/*.bb ${LAYERDIR}/recipes-*/*/*.bbappend"

BBFILE_COLLECTIONS += "modem"
BBFILE_PATTERN_modem = "^${LAYERDIR}/"
BBFILE_PRIORITY_modem = "7"

LAYERDEPENDS_modem = "core"
# PetaLinux 2021.1 dựa trên Yocto gatesgarth
LAYERSERIES_COMPAT_modem = "gatesgarth"
```

## meta-nckh/conf/layer.conf
```bitbake
BBPATH .= ":${LAYERDIR}"
BBFILES += "${LAYERDIR}/recipes-*/*/*.bb ${LAYERDIR}/recipes-*/*/*.bbappend"

BBFILE_COLLECTIONS += "nckh"
BBFILE_PATTERN_nckh = "^${LAYERDIR}/"
BBFILE_PRIORITY_nckh = "7"

LAYERDEPENDS_nckh = "core"
# PetaLinux 2023.x dựa trên Yocto langdale
LAYERSERIES_COMPAT_nckh = "langdale"
```
